// Generated by copilot on behalf of Andrii

#include "Utils/FileSystem.hpp"

// Reads the contents of a file at the given file path.
// @param filePath Path to the file to read.
// @return String containing the file contents, or empty string if not found
String FileSystem::Read(const String& filePath) {
    File file = SPIFFS.open(filePath, FILE_READ);
    if (!file) return "";
    String content = file.readString();
    file.close();
    return content;
}

// Creates a new file at the given file path (overwrites if exists).
// @param filePath Path to the file to create.
// @return true if file was created successfully, false otherwise
bool FileSystem::Create(const String& filePath) {
    File file = SPIFFS.open(filePath, FILE_WRITE);
    if (!file) return false;
    file.close();
    return true;
}

// Appends a line to a file at the given file path.
// @param filePath Path to the file to append to.
// @param data String to append as a new line.
// @return true if append was successful, false otherwise
bool FileSystem::Append(const String& filePath, const String& data) {
    File file = SPIFFS.open(filePath, FILE_APPEND);
    if (!file) return false;
    file.println(data);
    file.close();
    return true;
}

// Lists all files in the given directory.
// @param dirPath Path to the directory to list.
// @return Vector of file names as strings.
std::vector<String> FileSystem::List(const String& dirPath) {
    std::vector<String> files;
    File root = SPIFFS.open(dirPath);
    if (!root || !root.isDirectory()) return files;
    File file = root.openNextFile();
    while (file) {
        files.push_back(String(file.path()));
        file = root.openNextFile();
    }
    return files;
}

// Checks if a file exists at the given file path.
// @param filePath Path to the file to check.
// @return true if file exists, false otherwise.
bool FileSystem::Exists(const String& filePath) {
    return SPIFFS.exists(filePath);
}
